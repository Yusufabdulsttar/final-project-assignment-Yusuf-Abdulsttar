## meta-my-shell/conf/layer.conf
```bitbake
# We have a conf and classes directory, add to BBPATH
BBPATH .= ":${LAYERDIR}"

# We have recipes-* directories, add to BBFILES
BBFILES += "${LAYERDIR}/recipes-*/*/*.bb \
            ${LAYERDIR}/recipes-*/*/*.bbappend"

BBFILE_COLLECTIONS += "meta-my-shell"
BBFILE_PATTERN_meta-my-shell = "^${LAYERDIR}/"
BBFILE_PRIORITY_meta-my-shell = "6"

LAYERDEPENDS_meta-my-shell = "core"
LAYERSERIES_COMPAT_meta-my-shell = "hardknott kirkstone"
```
